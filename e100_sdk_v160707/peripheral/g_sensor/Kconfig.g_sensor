## e100_sdk_v160707/peripheral/g_sensor/Kconfig.g_sensor
```kconfig
menu "G-SENSOR Driver"

config G_SENSOR_ST_LIS3DE
        bool "G_SENSOR_ST_LIS3DE"
        default n

config G_SENSOR_MIRA_DA380
        bool "G_SENSOR_MIRA_DA380"
        default n
endmenu
```

## e100_sdk_v160707/peripheral/gps/Kconfig.gps
```kconfig
menu "GPS Driver"

config ECL_RADAR_MODEL
        bool "ECL_RADAR"
        default n

config GPS_UBLOX6_GM6XX
        bool "GPS_GM6XX"
        default n
endmenu
```

## e100_sdk_v160707/vendors/ecladas/Kconfig.ecl.adas
```kconfig
config ENABLE_ECL_ADAS
        bool "Enable ECL Video ADAS"
        default y

config BUILD_ECL_ADAS
        depends on ENABLE_ECL_ADAS
        bool "Build ECL ADAS"
        default n
```
